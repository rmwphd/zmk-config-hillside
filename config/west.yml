## config/west.yml
```yaml
manifest:
  remotes:
    - name: zmkfirmware
      url-base: https://github.com/zmkfirmware
    - name: rmwphd
      url-base: https://github.com/rmwphd
    - name: cdc-mkb
      url-base: https://github.com/cdc-mkb # name: zmk, revision: mouse-pim447
    - name: split-encoder
      url-base: https://github.com/petejohanson
  projects:
    - name: zmk
      remote: split-encoder
      revision: stephen/split-encoder
    # - name: zmk
    #   remote: zmkfirmware
    #   revision: main
      import: app/west.yml
  self:
    path: config
```
